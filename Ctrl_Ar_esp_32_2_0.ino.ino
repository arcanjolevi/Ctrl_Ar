#include "BluetoothSerial.h" 
#include <Wire.h>  
#include <IRremote.h>
#include "SSD1306Wire.h" 
#include "DHT.h"
#define DHTPIN 17
#define DHTTYPE DHT22
#define DEMO_DURATION 3000

IRsend irsend(5);
BluetoothSerial ESP_BT; 

DHT dht(DHTPIN, DHTTYPE);
SSD1306Wire  display(0x3c, 23, 18);


float h=0, t=0;
int incoming;
int khz = 38;
unsigned int ar_lab_on[] = {8484, 4150,  514, 542,  510, 538,  570, 1532,  516, 540,  514, 540,  512,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 1540,  512};
unsigned int ar_lab_off[] = {8436, 4198,  514, 536,  516, 536,  516, 1588,  516, 538,  514, 534,  516,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 1588,  516};
unsigned int ar_corredor_on [] = {8952, 4510,  524, 582,  552, 584,  550, 1682,  550, 582,  552, 1682,  552,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 1670,  550}; 
unsigned int ar_corredor_off []= {8952, 4508,  526, 580,  552, 582,  552, 1682,  552, 582,  550, 584,  548,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 570,  550};

unsigned int ar_corredor_18[]= {8952, 4502,  526, 582,  552, 582,  550, 1682,  552, 580,  552, 1680,  552,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 570,  550};
unsigned int ar_corredor_19[]= {8926, 4534,  524, 584,  550, 582,  550, 1682,  550, 582,  552, 1682,  550,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 1670,  550};
unsigned int ar_corredor_20[]= {8954, 4508,  526, 582,  552, 582,  552, 1680,  554, 580,  552, 1680,  552,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 568,  554}; 
unsigned int ar_corredor_21[]= {8952, 4510,  524, 582,  552, 584,  550, 1682,  550, 582,  552, 1682,  552,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 1670,  550}; 
unsigned int ar_corredor_22[]= {8952, 4510,  524, 582,  552, 580,  552, 1682,  552, 582,  550, 1682,  552,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 572,  550};
unsigned int ar_corredor_23[]= {8980, 4478,  522, 582,  550, 582,  550, 1684,  550, 582,  550, 1684,  550,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 1670,  552};
unsigned int ar_corredor_24[]= {9006, 4456,  522, 582,  550, 582,  550, 1684,  550, 582,  550, 1682,  552,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 572,  550};
unsigned int ar_corredor_25[]= {8970, 4486,  522, 584,  550, 584,  550, 1684,  550, 582,  550, 1682,  552,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 1672,  550};

unsigned int ar_lab_18[]= {8482, 4152,  566, 488,  566, 486,  558, 1548,  556, 1544,  566, 488,  564,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 1540,  564};
unsigned int ar_lab_19[]= {8482, 4152,  512, 538,  556, 496,  566, 1538,  562, 1548,  558, 486,  514,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 1590,  514};
unsigned int ar_lab_20[]= {124, 5760,  8434, 4198,  564, 486,  564, 488,  564, 1542,  560, 1542,  512,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 41264,  156}; 
unsigned int ar_lab_21[]= {8482, 4154,  558, 490,  562, 490,  562, 1544,  562, 1538,  566, 484,  564,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 1590,  558};
unsigned int ar_lab_22[]= {8480, 4152,  560, 490,  562, 490,  512, 1588,  564, 1542,  562, 488,  516,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 1590,  562};
unsigned int ar_lab_23[]= {8480, 4150,  562, 490,  566, 486,  564, 1540,  568, 1542,  562, 486,  512,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 1590,  514};
unsigned int ar_lab_24[]= {8482, 4152,  566, 488,  564, 484,  564, 1540,  514, 1590,  566, 486,  566,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 1542,  514}; 
unsigned int ar_lab_25[]= {8482, 4148,  564, 490,  556, 494,  564, 1540,  514, 1590,  564, 488,  560,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 1540,  560}; 
unsigned int ar_lab_26[]= {8432, 4200,  512, 540,  562, 486,  556, 1552,  512, 538,  562, 490,  514,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 1548,  560};

void gettemp(){
  delay(20); 
  h = dht.readHumidity();
  t = dht.readTemperature();
  
}

void displayambiente() {      
    display.setFont(ArialMT_Plain_16);
    display.drawString(30, 0, "Smart PTI");
    display.setFont(ArialMT_Plain_10); 
    display.drawString(15, 15, "Controle de Ambiente");
    display.setFont(ArialMT_Plain_16);
    display.drawString(18, 26, "Temp: " + String(t) + "C");
    display.drawString(15, 45, "Humid: " + String(h) + "%\t"); 
}

void setup() {
  Serial.begin(115200); 
  ESP_BT.begin("B5E3S9 SmartPTI Cinza"); 
  Serial.println("Bluetooth Device is Ready to Pair");
  
  dht.begin(); 
  display.init();
  display.flipScreenVertically();
  
}




void loop() {

  gettemp();  
  display.clear();  
  displayambiente();
  display.display();  
  delay(10);
  
  if (ESP_BT.available()) 
  {
    incoming = ESP_BT.read();
    Serial.print("Received:"); Serial.println(incoming);

     if (incoming == 49)// 18 c
        {
        irsend.sendRaw(ar_lab_18, sizeof(ar_lab_18) / sizeof(ar_lab_18[0]), khz); 
        irsend.sendRaw(ar_corredor_18, sizeof(ar_corredor_18) / sizeof(ar_corredor_18[0]), khz);
        Serial.println("Ar ON 18 \n");
        }
     if (incoming == 50)// 19 c
        {
        irsend.sendRaw(ar_lab_19, sizeof(ar_lab_19) / sizeof(ar_lab_19[0]), khz); 
        irsend.sendRaw(ar_corredor_19, sizeof(ar_corredor_19) / sizeof(ar_corredor_19[0]), khz);
        Serial.println("Ar ON 19 \n");
        }
    if (incoming == 51)// 20 c
        {
        irsend.sendRaw(ar_lab_20, sizeof(ar_lab_20) / sizeof(ar_lab_20[0]), khz); 
        irsend.sendRaw(ar_corredor_20, sizeof(ar_corredor_20) / sizeof(ar_corredor_20[0]), khz);
        Serial.println("Ar ON 20 \n");
        }
    if (incoming == 52)//ligar 21 c
        {
        irsend.sendRaw(ar_lab_21, sizeof(ar_lab_21) / sizeof(ar_lab_21[0]), khz); 
        irsend.sendRaw(ar_corredor_21, sizeof(ar_corredor_21) / sizeof(ar_corredor_21[0]), khz);
        Serial.println("Ar ON 21 \n");
        }
    if (incoming == 53)// 22 c
        {
        irsend.sendRaw(ar_lab_22, sizeof(ar_lab_22) / sizeof(ar_lab_22[0]), khz); 
        irsend.sendRaw(ar_corredor_22, sizeof(ar_corredor_22) / sizeof(ar_corredor_22[0]), khz);
        Serial.println("Ar ON 22 \n");
        }
    if (incoming == 54)// 23 c
        {
        irsend.sendRaw(ar_lab_23, sizeof(ar_lab_23) / sizeof(ar_lab_23[0]), khz); 
        irsend.sendRaw(ar_corredor_23, sizeof(ar_corredor_23) / sizeof(ar_corredor_23[0]), khz);
        Serial.println("Ar ON 23 \n");
        }
     if (incoming == 55)// 24 c
        {
        irsend.sendRaw(ar_lab_24, sizeof(ar_lab_24) / sizeof(ar_lab_24[0]), khz); 
        irsend.sendRaw(ar_corredor_24, sizeof(ar_corredor_24) / sizeof(ar_corredor_24[0]), khz);
        Serial.println("Ar ON 24 \n");
        }
     if (incoming == 56)// 25 c
        {
        irsend.sendRaw(ar_lab_25, sizeof(ar_lab_25) / sizeof(ar_lab_25[0]), khz); 
        irsend.sendRaw(ar_corredor_25, sizeof(ar_corredor_25) / sizeof(ar_corredor_25[0]), khz);
        Serial.println("Ar ON 25\n");
        }
     if (incoming == 57)// 26 c
        {
        irsend.sendRaw(ar_lab_26, sizeof(ar_lab_26) / sizeof(ar_lab_26[0]), khz); 
        irsend.sendRaw(ar_corredor_25, sizeof(ar_corredor_25) / sizeof(ar_corredor_25[0]), khz);
        Serial.println("Ar ON 26\n");
        }    
    if (incoming == 48)// ar OFF
        {
        irsend.sendRaw(ar_lab_off, sizeof(ar_lab_off) / sizeof(ar_lab_off[0]), khz); 
        irsend.sendRaw(ar_corredor_off, sizeof(ar_corredor_off) / sizeof(ar_corredor_off[0]), khz);
        Serial.println("Ar OFF \n");
        }     
  }
  delay(20);
}
